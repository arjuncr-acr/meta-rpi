## conf/layer.conf
```bitbake
# We have a conf and classes directory, append to BBPATH
BBPATH .= ":${LAYERDIR}"

# We have a recipes directory containing .bb and .bbappend files, add to BBFILES
BBFILES += "${LAYERDIR}/recipes*/*/*.bb \
            ${LAYERDIR}/recipes*/*/*.bbappend"

BBFILE_COLLECTIONS += "rpi"
BBFILE_PATTERN_rpi := "^${LAYERDIR}/"
BBFILE_PRIORITY_rpi = "12"
LAYERSERIES_COMPAT_rpi = "nanbield scarthgap"

LICENSE_FLAGS_ACCEPTED += "synaptics-killswitch"

EXTRA_USERS_PARAMS:append = " \
    useradd -p $(openssl passwd -1 pi@123) pi; \
    usermod -a -G sudo pi; \
    usermod -p $(openssl passwd -1 pi@123) root; \
    "
```
